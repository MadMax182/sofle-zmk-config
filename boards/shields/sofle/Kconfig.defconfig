## boards/shields/sofle/Kconfig.defconfig
```kconfig
# Copyright (c) 2020 Ryan Cross
# SPDX-License-Identifier: MIT

if SHIELD_SOFLE_LEFT || SHIELD_SOFLE_DONGLE_PRO_MICRO

config ZMK_KEYBOARD_NAME
    default "Sofle"

config BT_DEVICE_NAME
    default "Sofle"

config BT_DIS_MODEL
    default "Sofle" 

config ZMK_SPLIT_ROLE_CENTRAL
    default y

endif ##SHIELD_SOFLE_LEFT || SHIELD_SOFLE_DONGLE_PRO_MICRO


if SHIELD_SOFLE_RIGHT

config I2C
    default y

endif ##SHIELD_SOFLE_RIGHT


if SHIELD_SOFLE_LEFT || SHIELD_SOFLE_RIGHT || SHIELD_SOFLE_LEFT_PERIPHERAL || SHIELD_SOFLE_DONGLE_PRO_MICRO

config ZMK_POINTING
    default y

config ZMK_SPLIT
    default y

if ZMK_DISPLAY

config SSD1306
    default y

endif # ZMK_DISPLAY

endif ##SHIELD_SOFLE_LEFT || SHIELD_SOFLE_RIGHT || SHIELD_SOFLE_LEFT_PERIPHERAL || SHIELD_SOFLE_DONGLE_PRO_MICRO


if SHIELD_SOFLE_DONGLE_XIAO || SHIELD_SOFLE_DONGLE_PRO_MICRO

choice ZMK_DISPLAY_WORK_QUEUE
    default ZMK_DISPLAY_WORK_QUEUE_DEDICATED

endif ##SHIELD_SOFLE_DONGLE_XIAO || SHIELD_SOFLE_DONGLE_PRO_MICRO


if LVGL

config LV_Z_VDB_SIZE
    default 64

config LV_DPI_DEF
    default 148

config LV_Z_BITS_PER_PIXEL
    default 1

choice LV_COLOR_DEPTH
    default LV_COLOR_DEPTH_1

endif # LVGL


if ZMK_RGB_UNDERGLOW

config WS2812_STRIP
    default y
endif #ZMK_RGB_UNDERGLOW
```
